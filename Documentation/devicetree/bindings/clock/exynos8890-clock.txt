## Documentation/devicetree/bindings/iio/light/gp2ap002a00f.txt
```
* Sharp GP2AP002A00F I2C Proximity/ALS sensor

The proximity detector sensor requires power supply
for its built-in led. It is also defined by this binding.

Required properties:

  - compatible : should be "sharp,gp2ap002a00f"
  - reg : the I2C slave address of the light sensor
  - interrupts : interrupt specifier for the sole interrupt generated
		 by the device
  - vled-supply : VLED power supply, as covered in ../regulator/regulator.txt
  - vout-gpios : gpio connected to the vout pin (checked for the proximity status)
  - io-channels : phandle to the ADC connected to the light sensor output
  - io-channel-names : must be "light"

Optional properties:

  - wakeup-source : if the chip can be used to wakeup the system

Example:

gp2a@44 {
	compatible = "sharp,gp2ap002a00f";
	reg = <0x44>;
	vout-gpio = <&gph0 2 GPIO_ACTIVE_LOW>;
	vled-supply = <&gp2a_vled>;
	interrupt-parent = <&gph0>;
	interrupts = <2 IRQ_TYPE_EDGE_BOTH>;
	io-channels = <&adc 9>;
	io-channel-names = "light";

	wakeup-source;
};
```

## Documentation/devicetree/bindings/iio/magnetometer/yamaha,yas529.yaml
```yaml
# SPDX-License-Identifier: (GPL-2.0 OR BSD-2-Clause)
%YAML 1.2
---
$id: http://devicetree.org/schemas/iio/magnetometer/yamaha,yas529.yaml#
$schema: http://devicetree.org/meta-schemas/core.yaml#

title: |
  Yamaha YAS529 (MS-3C) magnetic field sensor

maintainers:
  - Jonathan Bakker <xc-racer2@live.ca>

description: |
  Triaxial geomagnetic sensor IC over an i2c interface.  No public datasheet.

properties:
  compatible:
    enum:
      - yamaha,yas529

  reg:
    maxItems: 1

  resetn-gpios:
    description: GPIO connected to resetn pin on the sensor

required:
  - compatible
  - reg
  - resetn-gpios

examples:
  - |
    #include <dt-bindings/gpio/gpio.h>

    yas529@2e {
    	compatible = "yamaha,yas529";
    	reg = <0x2e>;

    	resetn-gpios = <&gpb 1 GPIO_ACTIVE_HIGH>;
    };
...
```

## Documentation/devicetree/bindings/input/bosch,bma150.txt
```
* Bosch BMA150 Accelerometer Sensor

Also works for the SMB380 and BMA023 accelerometers

Required properties:
- compatible : Should be "bosch,bma150"
- reg : The I2C address of the sensor

Optional properties:
- interrupt-parent : should be the phandle for the interrupt controller
- interrupts : Interrupt mapping for IRQ.  If not present device will be polled
- any-motion-int : bool for if the any motion interrupt should be enabled
- hg-int : bool for if the high-G interrupt should be enabled
- lg-int : bool for if the low-G interrupt should be enabled
- any-motion-cfg : array of integers for any motion duration and threshold
- hg-cfg : array of integers for high-G hysterisis, duration, and threshold
- lg-cfg : array of integers for low-G hysterisis, duration, and threshold
- range : configuration of range, one of BMA150_RANGE_* as defined in [1]
- bandwidth : refresh rate of device, one of BMA150_BW_* as defined in [1]

Example:

bma150@38 {
	compatible = "bosch,bma150";
	reg = <0x38>;
	interrupt-parent = <&gph0>;
	interrupts = <1 IRQ_TYPE_EDGE_RISING>;
	any-motion-int;
	hg-int;
	lg-int;
	any-motion-cfg = <0 0>;
	hg-cfg = <0 150 160>;
	lg-cfg = <0 150 20>;
	range = <BMA150_RANGE_2G>;
	bandwidth = <BMA150_BW_50HZ>;
};

[1] include/dt-bindings/input/bma150.h
```

## Documentation/devicetree/bindings/input/sharp,gp2ap002a00f.txt
```
* Sharp GP2AP002A00F I2C Proximity/Opto Sensor

Required properties:
- compatible : Should be "sharp,gp2ap002a00f"
- reg : The I2C address of the sensor
- vout-gpio : The gpio connected to the vout pin
- interrupt-parent : should be the phandle for the interrupt controller
- interrupts : Interrupt mapping for GPIO IRQ, it should by configured with
		flags IRQ_TYPE_EDGE_BOTH

Optional properties:
- wakeup : If the device is capable of waking up the system
- io-channels : Phandle to an ADC channel connected to the light sensor
- io-channel-names = "light";
- poll-interval : Poll interval time in milliseconds, default 500ms
- light-adc-max : Maximum light value reported, default 4096
- light-adc-fuzz : Fuzz value for reported light value, default 80

Example:

gp2a@44 {
	compatible = "sharp,gp2ap002a00f";
	reg = <0x44>;
	vout-gpio = <&gph0 2 GPIO_ACTIVE_HIGH>;
	interrupt-parent = <&gph0>;
	interrupts = <2 IRQ_TYPE_EDGE_BOTH>;
	io-channels = <&adc 9>;
	io-channel-names = "light";
};
```

## Documentation/devicetree/bindings/media/samsung-s5ka3dfx.txt
```
Samsung S5KA3DFX VGA Image Sensor with embedded SoC ISP
--------------------------------------------------------------------

Required properties:

- compatible	  : "samsung,s5ka3dfx";
- reg		  : I2C slave address of the sensor;
- vddio-supply	  : 2.8V power supply
- isp_sys-supply  : 2.8V power supply
- dvdd-supply	  : 1.8V power supply
- isp_host-supply : 2.8V power supply
- nstandy-gpios	  : GPIO connected to nStandby pin;
- nreset-gpios	  : GPIO connected to nReset pin;
- clocks	  : list of phandle and clock specifier pairs
		    according to common clock bindings for the
		    clocks described in clock-names;
- clock-names	  : should include "mclk" for the sensor's master clock;

The device node should contain one 'port' child node with one child 'endpoint'
node, according to the bindings defined in Documentation/devicetree/bindings/
media/video-interfaces.txt. The following are properties specific to those
nodes.

Example:

	s5ka3dfx: sensor@62 {
		compatible = "samsung,s5ka3dfx";
		reg = <0x62>;

		clocks = <&camera 0>;
		clock-names = "mclk";

		vddio-supply = <&ldo13_reg>;
		isp_sys-supply = <&s5ka3dfx_isp_host_pwr>;
		dvdd-supply = <&ldo14_reg>;
		isp_host-supply = <&ldo15_reg>;

		nreset-gpios = <&gpb 2 GPIO_ACTIVE_HIGH>;
		nstandby-gpios = <&gpb 0 GPIO_ACTIVE_HIGH>;

		port {
			s5ka3dfx_ep: endpoint {
				remote-endpoint = <&fimc0_ep>;
				bus-type = <5>; /* Parallel */
				bus-width = <8>;
				hsync-active = <0>;
				vsync-active = <1>;
				pclk-sample = <1>;
			};
		};
	};
```

## Documentation/devicetree/bindings/mtd/samsung-onenand.txt
```
Device tree bindings for Samsung SoC OneNAND controller

Required properties:
 - compatible : value should be either of the following.
   (a) "samsung,s3c6400-onenand" - for onenand controller compatible with
       S3C6400 SoC,
   (b) "samsung,s3c6410-onenand" - for onenand controller compatible with
       S3C6410 SoC,
   (c) "samsung,s5pv210-onenand" - for onenand controller compatible with
       S5PC110/S5PV210 SoCs.

 - reg : memory mapped register region for the controller
 - interrupts : specifier of interrupt signal to which the OneNAND controller
   is wired; should contain just one entry.
 - clock-names : should contain two entries:
   - "bus" - bus clock of the controller,
   - "onenand" - clock supplied to OneNAND memory via the controller.
 - clock: should contain list of phandles and specifiers for all clocks listed
   in clock-names property.
 - #address-cells : should be 1
 - #size-cells : should be 1
 - ranges : must be present

Optional children nodes:
Individual OneNAND chips are children of the OneNAND controller node. Currently
only one OneNAND chip is supported.

Required children node properties:
 - reg : memory mapped register region for the chip.
 - #address-cells : should be 1
 - #size-cells : should be 1

Each child device node may optionally contain a 'partitions' sub-node,
which further contains sub-nodes describing the flash partition mapping.
See partition.txt for more detail.

Example for an s5pv210 board:

	onenand-controller@b0600000 {
		compatible = "samsung,s5pv210-onenand";
		reg = <0xb0600000 0x2000>;
		interrupt-parent = <&vic1>;
		interrupts = <31>;
		clock-names = "bus", "onenand";
		clocks = <&clocks NANDXL>, <&clocks DOUT_FLASH>;
		#address-cells = <1>;
		#size-cells = <1>;
		ranges;

		onenand@b0000000 {
			reg = <0xb0000000 0x20000>;
			#address-cells = <1>;
			#size-cells = <1>;
		};
	};
```

## arch/arm/configs/s5pv210_defconfig
```kconfig
CONFIG_SYSVIPC=y
CONFIG_NO_HZ=y
CONFIG_HIGH_RES_TIMERS=y
CONFIG_CGROUPS=y
CONFIG_SYSFS_DEPRECATED=y
CONFIG_SYSFS_DEPRECATED_V2=y
CONFIG_BLK_DEV_INITRD=y
CONFIG_KALLSYMS_ALL=y
CONFIG_MODULES=y
CONFIG_MODULE_UNLOAD=y
# CONFIG_BLK_DEV_BSG is not set
CONFIG_PARTITION_ADVANCED=y
CONFIG_BSD_DISKLABEL=y
CONFIG_SOLARIS_X86_PARTITION=y
CONFIG_ARCH_S5PV210=y
CONFIG_VMSPLIT_2G=y
CONFIG_PREEMPT=y
CONFIG_SECCOMP=y
CONFIG_AEABI=y
CONFIG_ARM_APPENDED_DTB=y
CONFIG_CMDLINE="root=/dev/ram0 rw ramdisk=8192 initrd=0x20800000,8M console=ttySAC1,115200 init=/linuxrc"
CONFIG_VFP=y
CONFIG_NEON=y
CONFIG_PM_DEBUG=y
CONFIG_NET=y
CONFIG_PACKET=y
CONFIG_UNIX=y
CONFIG_NET_KEY=y
CONFIG_INET=y
CONFIG_IP_MULTICAST=y
CONFIG_IP_PNP=y
CONFIG_IP_PNP_DHCP=y
CONFIG_IP_PNP_BOOTP=y
CONFIG_IP_PNP_RARP=y
CONFIG_DNS_RESOLVER=y
CONFIG_CFG80211=y
CONFIG_NFC=y
CONFIG_NFC_HCI=y
CONFIG_NFC_SHDLC=y
CONFIG_NFC_PN544_I2C=y
CONFIG_UEVENT_HELPER_PATH="/sbin/hotplug"
CONFIG_DEVTMPFS=y
CONFIG_DEVTMPFS_MOUNT=y
CONFIG_MTD=y
CONFIG_MTD_ONENAND=y
CONFIG_MTD_ONENAND_SAMSUNG=y
CONFIG_BLK_DEV_LOOP=y
CONFIG_BLK_DEV_RAM=y
CONFIG_BLK_DEV_RAM_SIZE=8192
CONFIG_SCSI=y
CONFIG_BLK_DEV_SD=y
CONFIG_CHR_DEV_SG=y
CONFIG_NETDEVICES=y
CONFIG_BRCMFMAC=y
CONFIG_INPUT_EVDEV=y
CONFIG_KEYBOARD_GPIO=y
# CONFIG_INPUT_MOUSE is not set
CONFIG_INPUT_TOUCHSCREEN=y
CONFIG_SERIAL_8250=y
CONFIG_SERIAL_SAMSUNG=y
CONFIG_SERIAL_SAMSUNG_CONSOLE=y
CONFIG_HW_RANDOM=y
CONFIG_I2C=y
CONFIG_I2C_GPIO=y
CONFIG_I2C_S3C2410=y
CONFIG_DEBUG_GPIO=y
# CONFIG_HWMON is not set
CONFIG_WATCHDOG=y
CONFIG_S3C2410_WATCHDOG=y
CONFIG_MFD_MAX8998=y
CONFIG_REGULATOR=y
CONFIG_REGULATOR_MAX8998=y
CONFIG_MEDIA_SUPPORT=y
CONFIG_MEDIA_CAMERA_SUPPORT=y
CONFIG_V4L_MEM2MEM_DRIVERS=y
CONFIG_VIDEO_SAMSUNG_S5P_G2D=y
CONFIG_VIDEO_SAMSUNG_S5P_JPEG=y
# CONFIG_USB_SUPPORT is not set
CONFIG_MMC=y
CONFIG_MMC_SDHCI=y
CONFIG_MMC_SDHCI_S3C=y
CONFIG_RTC_CLASS=y
CONFIG_RTC_DRV_S3C=y
CONFIG_EXT2_FS=y
CONFIG_EXT4_FS=y
CONFIG_AUTOFS4_FS=y
CONFIG_MSDOS_FS=y
CONFIG_VFAT_FS=y
CONFIG_TMPFS=y
CONFIG_TMPFS_POSIX_ACL=y
CONFIG_CONFIGFS_FS=y
CONFIG_CRAMFS=y
CONFIG_ROMFS_FS=y
CONFIG_NLS_CODEPAGE_437=y
CONFIG_NLS_ASCII=y
CONFIG_NLS_ISO8859_1=y
CONFIG_NLS_UTF8=y
CONFIG_PRINTK_TIME=y
CONFIG_DYNAMIC_DEBUG=y
CONFIG_DEBUG_INFO=y
CONFIG_DEBUG_FS=y
CONFIG_DEBUG_KERNEL=y
# CONFIG_DEBUG_PREEMPT is not set
CONFIG_DEBUG_RT_MUTEXES=y
CONFIG_DEBUG_SPINLOCK=y
CONFIG_DEBUG_MUTEXES=y
CONFIG_DEBUG_ATOMIC_SLEEP=y
CONFIG_KGDB=y
CONFIG_DEBUG_USER=y
CONFIG_DEBUG_LL=y
CONFIG_DEBUG_S3C_UART2=y
CONFIG_EARLY_PRINTK=y
CONFIG_CRC_CCITT=y
```

## drivers/soc/s5pv210/Kconfig
```kconfig
#
# S5PV210 SoC drivers
#
menuconfig SOC_S5PV210
	depends on ARCH_S5PV210 || COMPILE_TEST
	bool "S5PV210 SoC driver support"

if SOC_S5PV210

config S5PV210_PM_DOMAINS
	bool "Samsung S5PV210 and S5PC110 PM domains"
	depends on PM && OF
	select PM_GENERIC_DOMAINS
	select PM_GENERIC_DOMAINS_OF
	default y
	help
	  This adds the power domain driver for Samsung S5PV210 and
	  S5PC110 SoCs.

	  If in doubt, say N.

endif
```
