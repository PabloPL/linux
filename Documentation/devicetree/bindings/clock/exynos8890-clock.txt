## Documentation/devicetree/bindings/clock/exynos8890-clock.txt
```
* Samsung Exynos8890 CMU (Clock Management Units)

The Exynos8890 clock controller generates and supplies clock to various
controllers within the Exynos8890 SoC.

Required Properties:

- compatible: should be one of the following.
  - "samsung,exynos8890-cmu-aud"   - clock controller compatible for CMU AUD
  - "samsung,exynos8890-cmu-apollo"    - clock controller compatible for CMU APOLLO
  - "samsung,exynos8890-cmu-bus0"    - clock controller compatible for CMU BUS0
  - "samsung,exynos8890-cmu-bus1"   - clock controller compatible for CMU BUS1
  - "samsung,exynos8890-cmu-cam0-local"    - clock controller compatible for CMU CAM0 LOCAL
  - "samsung,exynos8890-cmu-cam0"   - clock controller compatible for CMU CAM0
  - "samsung,exynos8890-cmu-cam1-local"    - clock controller compatible for CMU CAM1 LOCAL
  - "samsung,exynos8890-cmu-cam1"   - clock controller compatible for CMU CAM1
  - "samsung,exynos8890-cmu-ccore"   - clock controller compatible for CMU CCORE
  - "samsung,exynos8890-cmu-disp0"   - clock controller compatible for CMU DISP0
  - "samsung,exynos8890-cmu-disp1"   - clock controller compatible for CMU DISP1
  - "samsung,exynos8890-cmu-fsys0"    - clock controller compatible for CMU FSYS0
  - "samsung,exynos8890-cmu-fsys1"    - clock controller compatible for CMU FSYS1
  - "samsung,exynos8890-cmu-g3d"    - clock controller compatible for CMU G3D
  - "samsung,exynos8890-cmu-imem"    - clock controller compatible for CMU IMEM
  - "samsung,exynos8890-cmu-isp0-local"    - clock controller compatible for CMU ISP0 LOCAL
  - "samsung,exynos8890-cmu-isp0"    - clock controller compatible for CMU IPS0
  - "samsung,exynos8890-cmu-isp1-local"    - clock controller compatible for CMU ISP1 LOCAL
  - "samsung,exynos8890-cmu-isp1"    - clock controller compatible for CMU ISP1
  - "samsung,exynos8890-cmu-mfc"    - clock controller compatible for CMU MFC
  - "samsung,exynos8890-cmu-mif0"    - clock controller compatible for CMU MIF0
  - "samsung,exynos8890-cmu-mif1"    - clock controller compatible for CMU MIF1
  - "samsung,exynos8890-cmu-mif2"    - clock controller compatible for CMU MIF2
  - "samsung,exynos8890-cmu-mif3"    - clock controller compatible for CMU MIF3
  - "samsung,exynos8890-cmu-mngs"    - clock controller compatible for CMU MNGS
  - "samsung,exynos8890-cmu-mscl"    - clock controller compatible for CMU MSCL
  - "samsung,exynos8890-cmu-peric0"     - clock controller compatible for CMU PERIC0
  - "samsung,exynos8890-cmu-peric1"    - clock controller compatible for CMU PERIC1
  - "samsung,exynos8890-cmu-peris"    - clock controller compatible for CMU PERIS
  - "samsung,exynos8890-cmu-top"    - clock controller compatible for CMU TOP

- reg: physical base address of the controller and length of memory mapped
  region.

- #clock-cells: should be 1.

- clocks: list of the clock controller input clock identifiers,
	from common clock bindings. Please refer the next section
	to find the input clocks for a given controller.

- clock-names: list of the clock controller input clock names,
	as described in clock-bindings.txt.

	Input clocks for peris clock controller:
		- oscclk
		- top_gate_aclk_peris_66
		- top_gate_sclk_promise_int

	Input clocks for top clock controller:
		- oscclk
		- mif0_pll
		- mif1_pll
		- mif2_pll
		- mif3_pll

	Input clocks for ccore clock controller:
		- oscclk
		- top_gate_aclk_ccore_800
		- top_gate_aclk_ccore_264
		- top_gate_aclk_ccore_g3d_800
		- top_gate_aclk_ccore_528
		- top_gate_aclk_ccore_132
		- top_gate_pclk_ccore_66

	Input clocks for mif0 clock controller:
		- oscclk
		- top_gate_sclk_bus_pll_mif

	Input clocks for mif1 clock controller:
		- oscclk
		- top_gate_sclk_bus_pll_mif

	Input clocks for mif2 clock controller:
		- oscclk
		- top_gate_sclk_bus_pll_mif

	Input clocks for mif3 clock controller:
		- oscclk
		- top_gate_sclk_bus_pll_mif

	Input clocks for fsys0 clock controller:
		- oscclk
		- top_gate_aclk_fsys0_200
		- top_gate_sclk_fsys0_usbdrd30
		- top_gate_sclk_fsys0_mmc0
		- top_gate_sclk_fsys0_ufsunipro20
		- top_gate_sclk_fsys0_phy_24m
		- top_gate_sclk_fsys0_ufsunipro_cfg
		- top_gate_sclk_promise_int

	Input clocks for imem clock controller:
		- oscclk
		- top_gate_aclk_imem_266
		- top_gate_aclk_imem_200
		- top_gate_aclk_imem_100

	Input clocks for aud clock controller:
		- oscclk
		- aud_pll

	Input clocks for mngs clock controller:
		- oscclk
		- top_gate_sclk_bus_pll_mngs

	Input clocks for apollo clock controller:
		- oscclk
		- top_gate_sclk_bus_pll_apollo

	Input clocks for bus0 clock controller:
		- oscclk
		- top_gate_aclk_bus0_528
		- top_gate_aclk_bus0_200
		- top_gate_pclk_bus0_132

	Input clocks for bus1 clock controller:
		- oscclk
		- top_gate_aclk_bus1_528
		- top_gate_pclk_bus1_132

	Input clocks for peric0 clock controller:
		- oscclk
		- top_gate_aclk_peric0_66
		- top_gate_sclk_peric0_uart0

	Input clocks for disp0 clock controller:
		- oscclk
		- top_gate_aclk_disp0_0_400
		- top_gate_aclk_disp0_1_400
		- top_gate_sclk_disp0_decon0_eclk0
		- top_gate_sclk_disp0_decon0_vclk0
		- top_gate_sclk_disp0_decon0_vclk1
		- top_gate_sclk_disp0_hdmi_audio
		- top_gate_sclk_promise_disp
		- top_gate_sclk_promise_int

	Input clocks for dip1 clock controller:
		- oscclk
		- top_gate_aclk_disp1_0_400
		- top_gate_aclk_disp1_1_400
		- top_gate_sclk_disp1_decon1_eclk0
		- top_gate_sclk_disp1_decon1_eclk1
		- disp0_gate_sclk_disp1_400
		- phyclk_mipidphy0_bitclkdiv2_phy
		- phyclk_mipidphy1_bitclkdiv2_phy
		- phyclk_mipidphy2_bitclkdiv2_phy
		- top_gate_sclk_promise_disp
		- top_gate_sclk_promise_int

	Input clocks for cam0 local clock controller:
		- cam0_gate_aclk_bns
		- cam0_gate_aclk_pxl_asbs_csis2_int
		- cam0_gate_aclk_csis0
		- cam0_gate_pclk_bns
		- cam0_gate_aclk_csis1
		- cam0_gate_aclk_csis2
		- cam0_gate_aclk_csis3
		- cam0_gate_aclk_3aa0
		- cam0_gate_pclk_3aa0
		- cam0_gate_aclk_3aa1
		- cam0_gate_pclk_3aa1
		- cam0_gate_pclk_csis1
		- cam0_gate_pclk_csis0

	Input clocks for cam0 clock controller:
		- oscclk
		- top_gate_aclk_cam0_csis0_414
		- top_gate_aclk_cam0_csis1_168
		- top_gate_aclk_cam0_csis2_234
		- top_gate_aclk_cam0_csis3_132
		- top_gate_aclk_cam0_3aa0_414
		- top_gate_aclk_cam0_3aa1_414
		- top_gate_aclk_cam0_trex_528
		- top_gate_sclk_promise_disp

	Input clocks for cam1 local clock controller:
		- cam1_gate_aclk_vra
		- cam1_gate_pclk_vra
		- cam1_gate_pclk_csis3
		- cam1_gate_pclk_csis2
		- cam1_gate_pclk_wdt
		- cam1_gate_pclk_uart
		- cam1_gate_pclk_spi1
		- cam1_gate_pclk_spi0
		- cam1_gate_pclk_pwm
		- cam1_gate_pclk_mcuctl
		- cam1_gate_pclk_i2c3
		- cam1_gate_pclk_i2c2
		- cam1_gate_pclk_i2c1
		- cam1_gate_pclk_i2c0
		- cam1_gate_aclk_pdma
		- cam1_gate_aclk_csis2
		- cam1_gate_aclk_csis3
		- cam1_gate_aclk_mc_sc

	Input clocks for cam1 clock controller:
		- oscclk
		- top_gate_aclk_cam1_arm_672
		- top_gate_aclk_cam1_trex_vra_528
		- top_gate_aclk_cam1_trex_b_528
		- top_gate_aclk_cam1_bus_264
		- top_gate_aclk_cam1_peri_84
		- top_gate_aclk_cam1_csis2_414
		- top_gate_aclk_cam1_csis3_132
		- top_gate_aclk_cam1_scl_566
		- top_gate_sclk_cam1_isp_spi0
		- top_gate_sclk_cam1_isp_spi1
		- top_gate_sclk_cam1_isp_uart

	Input clocks for isp0 local clock controller:
		- isp0_gate_aclk_fimc_isp0
		- isp0_gate_pclk_fimc_isp0
		- isp0_gate_aclk_fimc_tpu
		- isp0_gate_pclk_fimc_tpu
		- isp0_gate_clk_c_trex_c
		- isp0_gate_pclk_trex_c

	Input clocks for isp0 clock controller:
		- oscclk
		- top_gate_aclk_isp0_isp0_528
		- top_gate_aclk_isp0_tpu_400
		- top_gate_aclk_isp0_trex_528
		- top_gate_aclk_isp0_pxl_asbs_is_c_from_is_d
		- top_gate_sclk_promise_int

	Input clocks for isp1 local clock controller:
		- isp1_gate_aclk_fimc_isp1
		- isp1_gate_pclk_fimc_isp1

	Input clocks for isp1 clock controller:
		- oscclk
		- top_gate_aclk_isp1_isp1_468
		- top_gate_sclk_promise_int

	Input clocks for g3d clock controller:
		- oscclk
		- g3d_pll
		- top_gate_sclk_bus_pll_g3d

	Input clocks for peric1 clock controller:
		- oscclk
		- top_gate_aclk_peric1_66
		- top_gate_sclk_peric1_spi0
		- top_gate_sclk_peric1_spi1
		- top_gate_sclk_peric1_spi2
		- top_gate_sclk_peric1_spi3
		- top_gate_sclk_peric1_spi4
		- top_gate_sclk_peric1_spi5
		- top_gate_sclk_peric1_spi6
		- top_gate_sclk_peric1_spi7
		- top_gate_sclk_peric1_uart1
		- top_gate_sclk_peric1_uart2
		- top_gate_sclk_peric1_uart3
		- top_gate_sclk_peric1_uart4
		- top_gate_sclk_peric1_uart5

	Input clocks for mscl clock controller:
		- oscclk
		- top_gate_aclk_mscl0_528
		- top_gate_aclk_mscl1_528

	Input clocks for mfc clock controller:
		- oscclk
		- top_gate_aclk_mfc_600
		- top_gate_sclk_promise_int

	Input clocks for fsys1 clock controller:
		- oscclk
		- top_gate_aclk_fsys1_200
		- top_gate_sclk_fsys1_mmc2
		- top_gate_sclk_fsys1_ufsunipro20
		- top_gate_sclk_fsys1_ufsunipro_cfg
		- top_gate_sclk_fsys1_pcie_phy
		- top_gate_sclk_promise_int

Optional properties:
  - power-domains: a phandle to respective power domain node as described by
	generic PM domain bindings (see power/power_domain.txt for more
	information).

Each clock is assigned an identifier and client nodes can use this identifier
to specify the clock which they consume.

All available clocks are defined as preprocessor macros in
dt-bindings/clock/exynos8890.h header and can be used in device
tree sources.

Example 1: Examples of 'oscclk' source clock node are listed below.

	xxti: xxti {
		compatible = "fixed-clock";
		clock-output-names = "oscclk";
		#clock-cells = <0>;
	};

Example 2: Examples of clock controller nodes are listed below.

	cmu_top: clock-controller@10030000 {
		compatible = "samsung,exynos8890-cmu-top";
		reg = <0x10030000 0x0c04>;
		#clock-cells = <1>;

		clock-names = "oscclk",
			"sclk_mphy_pll",
			"sclk_mfc_pll",
			"sclk_bus_pll";
		clocks = <&xxti>,
		       <&cmu_cpif CLK_SCLK_MPHY_PLL>,
		       <&cmu_mif CLK_SCLK_MFC_PLL>,
		       <&cmu_mif CLK_SCLK_BUS_PLL>;
	};

	cmu_cpif: clock-controller@10fc0000 {
		compatible = "samsung,exynos8890-cmu-cpif";
		reg = <0x10fc0000 0x0c04>;
		#clock-cells = <1>;

		clock-names = "oscclk";
		clocks = <&xxti>;
	};

	cmu_mif: clock-controller@105b0000 {
		compatible = "samsung,exynos8890-cmu-mif";
		reg = <0x105b0000 0x100c>;
		#clock-cells = <1>;

		clock-names = "oscclk",
			"sclk_mphy_pll";
		clocks = <&xxti>,
		       <&cmu_cpif CLK_SCLK_MPHY_PLL>;
	};

	cmu_peric: clock-controller@14c80000 {
		compatible = "samsung,exynos8890-cmu-peric";
		reg = <0x14c80000 0x0b08>;
		#clock-cells = <1>;
	};

	cmu_peris: clock-controller@10040000 {
		compatible = "samsung,exynos8890-cmu-peris";
		reg = <0x10040000 0x0b20>;
		#clock-cells = <1>;
	};

	cmu_fsys: clock-controller@156e0000 {
		compatible = "samsung,exynos8890-cmu-fsys";
		reg = <0x156e0000 0x0b04>;
		#clock-cells = <1>;

		clock-names = "oscclk",
			"sclk_ufs_mphy",
			"aclk_fsys_200",
			"sclk_pcie_100_fsys",
			"sclk_ufsunipro_fsys",
			"sclk_mmc2_fsys",
			"sclk_mmc1_fsys",
			"sclk_mmc0_fsys",
			"sclk_usbhost30_fsys",
			"sclk_usbdrd30_fsys";
		clocks = <&xxti>,
		       <&cmu_cpif CLK_SCLK_UFS_MPHY>,
		       <&cmu_top CLK_ACLK_FSYS_200>,
		       <&cmu_top CLK_SCLK_PCIE_100_FSYS>,
		       <&cmu_top CLK_SCLK_UFSUNIPRO_FSYS>,
		       <&cmu_top CLK_SCLK_MMC2_FSYS>,
		       <&cmu_top CLK_SCLK_MMC1_FSYS>,
		       <&cmu_top CLK_SCLK_MMC0_FSYS>,
		       <&cmu_top CLK_SCLK_USBHOST30_FSYS>,
		       <&cmu_top CLK_SCLK_USBDRD30_FSYS>;
	};

	cmu_g2d: clock-controller@12460000 {
		compatible = "samsung,exynos8890-cmu-g2d";
		reg = <0x12460000 0x0b08>;
		#clock-cells = <1>;

		clock-names = "oscclk",
			"aclk_g2d_266",
			"aclk_g2d_400";
		clocks = <&xxti>,
		       <&cmu_top CLK_ACLK_G2D_266>,
		       <&cmu_top CLK_ACLK_G2D_400>;
		power-domains = <&pd_g2d>;
	};

	cmu_disp: clock-controller@13b90000 {
		compatible = "samsung,exynos8890-cmu-disp";
		reg = <0x13b90000 0x0c04>;
		#clock-cells = <1>;

		clock-names = "oscclk",
			"sclk_dsim1_disp",
			"sclk_dsim0_disp",
			"sclk_dsd_disp",
			"sclk_decon_tv_eclk_disp",
			"sclk_decon_vclk_disp",
			"sclk_decon_eclk_disp",
			"sclk_decon_tv_vclk_disp",
			"aclk_disp_333";
		clocks = <&xxti>,
		       <&cmu_mif CLK_SCLK_DSIM1_DISP>,
		       <&cmu_mif CLK_SCLK_DSIM0_DISP>,
		       <&cmu_mif CLK_SCLK_DSD_DISP>,
		       <&cmu_mif CLK_SCLK_DECON_TV_ECLK_DISP>,
		       <&cmu_mif CLK_SCLK_DECON_VCLK_DISP>,
		       <&cmu_mif CLK_SCLK_DECON_ECLK_DISP>,
		       <&cmu_mif CLK_SCLK_DECON_TV_VCLK_DISP>,
		       <&cmu_mif CLK_ACLK_DISP_333>;
		power-domains = <&pd_disp>;
	};

	cmu_aud: clock-controller@114c0000 {
		compatible = "samsung,exynos8890-cmu-aud";
		reg = <0x114c0000 0x0b04>;
		#clock-cells = <1>;

		clock-names = "oscclk", "fout_aud_pll";
		clocks = <&xxti>, <&cmu_top CLK_FOUT_AUD_PLL>;
		power-domains = <&pd_aud>;
	};

	cmu_bus0: clock-controller@13600000 {
		compatible = "samsung,exynos8890-cmu-bus0";
		reg = <0x13600000 0x0b04>;
		#clock-cells = <1>;

		clock-names = "aclk_bus0_400";
		clocks = <&cmu_top CLK_ACLK_BUS0_400>;
	};

	cmu_bus1: clock-controller@14800000 {
		compatible = "samsung,exynos8890-cmu-bus1";
		reg = <0x14800000 0x0b04>;
		#clock-cells = <1>;

		clock-names = "aclk_bus1_400";
		clocks = <&cmu_top CLK_ACLK_BUS1_400>;
	};

	cmu_bus2: clock-controller@13400000 {
		compatible = "samsung,exynos8890-cmu-bus2";
		reg = <0x13400000 0x0b04>;
		#clock-cells = <1>;

		clock-names = "oscclk", "aclk_bus2_400";
		clocks = <&xxti>, <&cmu_mif CLK_ACLK_BUS2_400>;
	};

	cmu_g3d: clock-controller@14aa0000 {
		compatible = "samsung,exynos8890-cmu-g3d";
		reg = <0x14aa0000 0x1000>;
		#clock-cells = <1>;

		clock-names = "oscclk", "aclk_g3d_400";
		clocks = <&xxti>, <&cmu_top CLK_ACLK_G3D_400>;
		power-domains = <&pd_g3d>;
	};

	cmu_gscl: clock-controller@13cf0000 {
		compatible = "samsung,exynos8890-cmu-gscl";
		reg = <0x13cf0000 0x0b10>;
		#clock-cells = <1>;

		clock-names = "oscclk",
			"aclk_gscl_111",
			"aclk_gscl_333";
		clocks = <&xxti>,
			<&cmu_top CLK_ACLK_GSCL_111>,
			<&cmu_top CLK_ACLK_GSCL_333>;
		power-domains = <&pd_gscl>;
	};

	cmu_apollo: clock-controller@11900000 {
		compatible = "samsung,exynos8890-cmu-apollo";
		reg = <0x11900000 0x1088>;
		#clock-cells = <1>;

		clock-names = "oscclk", "sclk_bus_pll_apollo";
		clocks = <&xxti>, <&cmu_mif CLK_SCLK_BUS_PLL_APOLLO>;
	};

	cmu_atlas: clock-controller@11800000 {
		compatible = "samsung,exynos8890-cmu-atlas";
		reg = <0x11800000 0x1088>;
		#clock-cells = <1>;

		clock-names = "oscclk", "sclk_bus_pll_atlas";
		clocks = <&xxti>, <&cmu_mif CLK_SCLK_BUS_PLL_ATLAS>;
	};

	cmu_mscl: clock-controller@105d0000 {
		compatible = "samsung,exynos8890-cmu-mscl";
		reg = <0x105d0000 0x0b10>;
		#clock-cells = <1>;

		clock-names = "oscclk",
			"sclk_jpeg_mscl",
			"aclk_mscl_400";
		clocks = <&xxti>,
		       <&cmu_top CLK_SCLK_JPEG_MSCL>,
		       <&cmu_top CLK_ACLK_MSCL_400>;
		power-domains = <&pd_mscl>;
	};

	cmu_mfc: clock-controller@15280000 {
		compatible = "samsung,exynos8890-cmu-mfc";
		reg = <0x15280000 0x0b08>;
		#clock-cells = <1>;

		clock-names = "oscclk", "aclk_mfc_400";
		clocks = <&xxti>, <&cmu_top CLK_ACLK_MFC_400>;
		power-domains = <&pd_mfc>;
	};

	cmu_hevc: clock-controller@14f80000 {
		compatible = "samsung,exynos8890-cmu-hevc";
		reg = <0x14f80000 0x0b08>;
		#clock-cells = <1>;

		clock-names = "oscclk", "aclk_hevc_400";
		clocks = <&xxti>, <&cmu_top CLK_ACLK_HEVC_400>;
		power-domains = <&pd_hevc>;
	};

	cmu_isp: clock-controller@146d0000 {
		compatible = "samsung,exynos8890-cmu-isp";
		reg = <0x146d0000 0x0b0c>;
		#clock-cells = <1>;

		clock-names = "oscclk",
			"aclk_isp_dis_400",
			"aclk_isp_400";
		clocks = <&xxti>,
		       <&cmu_top CLK_ACLK_ISP_DIS_400>,
		       <&cmu_top CLK_ACLK_ISP_400>;
		power-domains = <&pd_isp>;
	};

	cmu_cam0: clock-controller@120d0000 {
		compatible = "samsung,exynos8890-cmu-cam0";
		reg = <0x120d0000 0x0b0c>;
		#clock-cells = <1>;

		clock-names = "oscclk",
			"aclk_cam0_333",
			"aclk_cam0_400",
			"aclk_cam0_552";
		clocks = <&xxti>,
		       <&cmu_top CLK_ACLK_CAM0_333>,
		       <&cmu_top CLK_ACLK_CAM0_400>,
		       <&cmu_top CLK_ACLK_CAM0_552>;
		power-domains = <&pd_cam0>;
	};

	cmu_cam1: clock-controller@145d0000 {
		compatible = "samsung,exynos8890-cmu-cam1";
		reg = <0x145d0000 0x0b08>;
		#clock-cells = <1>;

		clock-names = "oscclk",
			"sclk_isp_uart_cam1",
			"sclk_isp_spi1_cam1",
			"sclk_isp_spi0_cam1",
			"aclk_cam1_333",
			"aclk_cam1_400",
			"aclk_cam1_552";
		clocks = <&xxti>,
		       <&cmu_top CLK_SCLK_ISP_UART_CAM1>,
		       <&cmu_top CLK_SCLK_ISP_SPI1_CAM1>,
		       <&cmu_top CLK_SCLK_ISP_SPI0_CAM1>,
		       <&cmu_top CLK_ACLK_CAM1_333>,
		       <&cmu_top CLK_ACLK_CAM1_400>,
		       <&cmu_top CLK_ACLK_CAM1_552>;
		power-domains = <&pd_cam1>;
	};

	cmu_imem: clock-controller@11060000 {
		compatible = "samsung,exynos8890-cmu-imem";
		reg = <0x11060000 0x1000>;
		#clock-cells = <1>;

		clock-names = "oscclk",
			"aclk_imem_sssx_266",
			"aclk_imem_266",
			"aclk_imem_200";
		clocks = <&xxti>,
			<&cmu_top CLK_DIV_ACLK_IMEM_SSSX_266>,
			<&cmu_top CLK_DIV_ACLK_IMEM_266>,
			<&cmu_top CLK_DIV_ACLK_IMEM_200>;
	};

Example 3: UART controller node that consumes the clock generated by the clock
	   controller.

	serial_0: serial@14c10000 {
		compatible = "samsung,exynos5433-uart";
		reg = <0x14C10000 0x100>;
		interrupts = <0 421 0>;
		clocks = <&cmu_peric CLK_PCLK_UART0>,
			 <&cmu_peric CLK_SCLK_UART0>;
		clock-names = "uart", "clk_uart_baud0";
		pinctrl-names = "default";
		pinctrl-0 = <&uart0_bus>;
	};
```
